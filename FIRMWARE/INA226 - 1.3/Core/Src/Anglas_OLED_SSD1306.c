/*
 * Anglas_OLED_SSD1306.c
 *
 *  Created on: Oct 25, 2022
 *      Author: PC
 */

/* Includes ------------------------------------------------------------------*/
#include "main.h"
#include "Anglas_OLED_SSD1306.h"

/* -------------------------------------------------------------------------
 * Fix cho OLED 1.3 inch dùng controller SH1106.
 *
 * Lý do sửa:
 * - SH1106 không dùng tốt bộ lệnh SSD1306_COLUMNADDR(0x21)/PAGEADDR(0x22)
 *   như thư viện cũ.
 * - SH1106 có RAM 132 cột, màn 128 cột thường bắt đầu lệch +2 cột.
 * - Gửi 1024 byte một phát khi clear dễ gây nháy/nhiễu trên một số module I2C.
 *
 * Nếu chữ bị lệch trái/phải, thử đổi SH1106_COL_OFFSET từ 2 sang 0 hoặc 4.
 * ------------------------------------------------------------------------- */
#ifndef SH1106_COL_OFFSET
#define SH1106_COL_OFFSET    2
#endif

#define OLED_I2C_TIMEOUT     100
#define OLED_PAGE_COUNT      (SSD1306_LCDHEIGHT / 8)

static void OLED_Write_Command_1byte(uint8_t byte1)
{
	uint8_t datos[2] = {CMD, byte1};
	HAL_I2C_Master_Transmit(&hi2c1, SSD1306_I2C_ADDRESS, datos, 2, OLED_I2C_TIMEOUT);
}

static void OLED_Set_Pos_SH1106(uint8_t page, uint8_t col)
{
	uint8_t real_col;

	if(page >= OLED_PAGE_COUNT) return;
	if(col >= SSD1306_LCDWIDTH) return;

	real_col = col + SH1106_COL_OFFSET;

	/* SH1106 page addressing */
	OLED_Write_Command_1byte(0xB0 | (page & 0x0F));
	OLED_Write_Command_1byte(0x00 | (real_col & 0x0F));
	OLED_Write_Command_1byte(0x10 | ((real_col >> 4) & 0x0F));
}

static void OLED_Write_Data_Buffer(const uint8_t *buffer, uint16_t length)
{
	uint8_t datos[129];
	uint16_t i;

	/* Gửi tối đa 128 byte data + 1 byte control DAT. */
	if(length > SSD1306_LCDWIDTH) length = SSD1306_LCDWIDTH;

	datos[0] = DAT;
	for(i = 0; i < length; i++){
		datos[i + 1] = buffer[i];
	}

	HAL_I2C_Master_Transmit(&hi2c1, SSD1306_I2C_ADDRESS, datos, length + 1, OLED_I2C_TIMEOUT);
}

/* Exported types ------------------------------------------------------------*/
/* Exported constant ---------------------------------------------------------*/
/* Exported macros -----------------------------------------------------------*/
/* Private macros ------------------------------------------------------------*/
/* Variables -----------------------------------------------------------------*/
/* Private functions ---------------------------------------------------------*/
/* Exported functions --------------------------------------------------------*/
const uint8_t FONT_1[552] =       //Matriz de 1x552 (1fila-552columnas) y lo ordeno en funcion a columnas de 6 en 6 (por el ancho del FONT_1)
{
	0x00, 0x00, 0x00, 0x00, 0x00, 0x00,   // sp      6x0=0  (posicion de inicio del arreglo)
	0x00, 0x00, 0x00, 0x2f, 0x00, 0x00,   // !		 6x1=6  (posicion de inicio del arreglo)
	0x00, 0x00, 0x07, 0x00, 0x07, 0x00,   // "		 6x2=12 (posicion de inicio del arreglo)
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	0x14, 0x14, 0x14, 0x14, 0x14, 0x14    // horiz lines
};


const uint8_t FONT_2[1710] =      //Matriz de 1x1710 (1fila-1710columnas) y lo ordeno en funcion a columnas de 18 en 18 (por el ancho del (FONT_2*2) ya que usara 16pixeles de alto que son 2 paginas)
{   //Para dibujar los caracteres: las 9 primeras columnas van a la pag0 col0,col1,....,col7 y las siguientes 9 columnas van a la pag1 col0,col1,....,col7
	0x00, 0x00, 0x00, 0x00, 0x00, 0x00, 0x00, 0x00, 0x00, 0x00, 0x00, 0x00, 0x00, 0x00, 0x00, 0x00, 0x00, 0x00,// 20  32     18x0=0   (posicion de inicio del arreglo)
	0x00, 0x00, 0x3E, 0xFF, 0xFF, 0x3E, 0x00, 0x00, 0x00, 0x00, 0x00, 0x00, 0x33, 0x33, 0x00, 0x00, 0x00, 0x00,// 21  33 !   18x1=18  (posicion de inicio del arreglo)
	0x00, 0x07, 0x07, 0x00, 0x00, 0x07, 0x07, 0x00, 0x00, 0x00, 0x00, 0x00, 0x00, 0x00, 0x00, 0x00, 0x00, 0x00,// 22  34 "   18x2=36  (posicion de inicio del arreglo)
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	0x02, 0x02, 0x01, 0x01, 0x02, 0x02, 0x01, 0x01, 0x00, 0x00, 0x00, 0x00, 0x00, 0x00, 0x00, 0x00, 0x00, 0x00 // 7E 126 ~
};

const uint8_t FONT_3[5760] =
{
        0x00, 0x00, 0x00, 0x00, 0x00, 0x00, 0x00, 0x00, 0x00, 0x00, 0x00, 0x00,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 0x00,  // Code for char
        0x00, 0x00, 0x00, 0x00, 0x00, 0x00, 0xFE, 0x1F, 0xF0, 0xFE, 0xFF, 0xF7,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 0x00,  // Code for char !
        0x00, 0x00, 0x00, 0xFE, 0x00, 0x00, 0xFE, 0x01, 0x00, 0xFE, 0x01, 0x00, 0xFE, 0x00, 0x00, 0x00, 0x00, 0x00, 0x00, 0x00, 0x00, 0xFE, 0x00, 0x00, 0xFE, 0x01, 0x00, 0xFE, 0x01, 0x00, 0xFE, 0x00, 0x00, 0x00, 0x00, 0x00, 0x00, 0x00, 0x00, 0x00, 0x00, 0x00, 0x00, 0x00, 0x00, 0x00, 0x00, 0x00, 0x00, 0x00, 0x00, 0x00, 0x00, 0x00, 0x00, 0x00, 0x00, 0x00, 0x00, 0x00,  // Code for char "
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        0x00, 0x00, 0x00, 0xFF, 0xFF, 0x7F, 0xFF, 0xFF, 0x7F, 0x01, 0x00, 0x60,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 0x00, 0x00   // Code for char 
        };
////////////////////////// EMPEZAMOS CON LA INICIALIZACION///////////////////////////////////////////////
//La direccion del OLED es la siguiente (depende del pin SA0 si esta conectado a GND o VCC):
//011110 + SA0=0 + R/W=0 ---> 0b01111000 = 0x78
//011110 + SA0=1 + R/W=0 ---> 0b01111010 = 0x7A

//Ahora debemos saber si vamos a mandar un byte de datos que sera: un COMANDO ó datos que se almacenaran en la GDDRAM (ram del oled)
//Para esto necesitamos tener el control de estos bits
	//bit7 -> Co=0  : la transmicion de la siguiente informacion sera un "byte de datos"
	//bit6 -> D/C#=0: el "byte de datos" actuara como un comando(CMD)
	//bit5 al bit0 se llena de ceros
	//0b00000000 = 0x00

	//bit 7 -> Co=0  : la transmicion de la siguiente informacion sera un "byte de datos"
	//bit 6 -> D/C#=1: el "byte de datos" sera un dato almacenado en la GDDRAM (DAT)
	//bit5 al bit0 se llena de ceros
	//0b01000000 = 0x40

//Funcion para mandar un byte de datos que actuara como "comando" o "dato"


void OLED_Init(void){

	/* Init theo kiểu SH1106 128x64 I2C.
	 * Giữ tên hàm cũ để main.c không phải sửa.
	 */
	HAL_Delay(100);

	OLED_Write_Command_1byte(0xAE);                    // Display OFF
	OLED_Write_Command_1byte(0xD5); OLED_Write_Command_1byte(0x80); // clock div
	OLED_Write_Command_1byte(0xA8); OLED_Write_Command_1byte(SSD1306_LCDHEIGHT - 1); // multiplex
	OLED_Write_Command_1byte(0xD3); OLED_Write_Command_1byte(0x00); // display offset
	OLED_Write_Command_1byte(0x40);                    // start line = 0

	/* SH1106 DC-DC converter ON. Nếu module của bro vẫn tối đen, thử đổi 0x8B -> 0x8A. */
	OLED_Write_Command_1byte(0xAD); OLED_Write_Command_1byte(0x8B);

	OLED_Write_Command_1byte(0xA1);                    // segment remap
	OLED_Write_Command_1byte(0xC8);                    // COM scan direction
	OLED_Write_Command_1byte(0xDA); OLED_Write_Command_1byte(0x12); // COM pins
	OLED_Write_Command_1byte(0x81); OLED_Write_Command_1byte(0xCF); // contrast
	OLED_Write_Command_1byte(0xD9); OLED_Write_Command_1byte(0xF1); // precharge
	OLED_Write_Command_1byte(0xDB); OLED_Write_Command_1byte(0x40); // VCOMH
	OLED_Write_Command_1byte(0xA4);                    // resume RAM display
	OLED_Write_Command_1byte(0xA6);                    // normal display

	OLED_Clear();
	OLED_Write_Command_1byte(0xAF);                    // Display ON
}

void OLED_Write_Command_3bytes(uint8_t byte1, uint8_t byte2, uint8_t byte3){
	/* Giữ hàm cũ cho tương thích. Với SH1106, các thao tác vẽ chính không dùng
	 * PAGEADDR/COLUMNADDR nữa mà dùng OLED_Set_Pos_SH1106().
	 */
	uint8_t datos[4] = {CMD, byte1, byte2, byte3};
	HAL_I2C_Master_Transmit (&hi2c1, SSD1306_I2C_ADDRESS, (uint8_t*)datos, 4, OLED_I2C_TIMEOUT);
}

void OLED_Write_Data_1byte(uint8_t byte1){
	uint8_t datos[2] = {DAT, byte1};
	HAL_I2C_Master_Transmit (&hi2c1, SSD1306_I2C_ADDRESS, (uint8_t*)datos, 2, OLED_I2C_TIMEOUT);
}

void OLED_Draw_Pixel(uint8_t pag_inicio, uint8_t pag_final, uint8_t col_inicio, uint16_t col_final, uint8_t pixel){
	uint8_t page;
	uint16_t col;

	if(pag_inicio >= OLED_PAGE_COUNT) return;
	if(pag_final >= OLED_PAGE_COUNT) pag_final = OLED_PAGE_COUNT - 1;
	if(col_inicio >= SSD1306_LCDWIDTH) return;
	if(col_final >= SSD1306_LCDWIDTH) col_final = SSD1306_LCDWIDTH - 1;
	if(col_final < col_inicio) return;

	for(page = pag_inicio; page <= pag_final; page++){
		for(col = col_inicio; col <= col_final; col++){
			OLED_Set_Pos_SH1106(page, (uint8_t)col);
			OLED_Write_Data_1byte(pixel);
		}
	}
}

void OLED_Clear(void){
	uint8_t page;
	uint8_t col;
	uint8_t zeros[SSD1306_LCDWIDTH];

	for(col = 0; col < SSD1306_LCDWIDTH; col++){
		zeros[col] = 0x00;
	}

	/* SH1106: clear theo từng page, mỗi page 128 byte. Không gửi 1024 byte một phát. */
	for(page = 0; page < OLED_PAGE_COUNT; page++){
		OLED_Set_Pos_SH1106(page, 0);
		OLED_Write_Data_Buffer(zeros, SSD1306_LCDWIDTH);
	}
}

void OLED_Draw_8_Pixel(uint8_t pag_inicio, uint8_t col_inicio, uint8_t pixel_8bits){
	if(pag_inicio >= OLED_PAGE_COUNT) return;
	if(col_inicio >= SSD1306_LCDWIDTH) return;

	OLED_Set_Pos_SH1106(pag_inicio, col_inicio);
	OLED_Write_Data_1byte(pixel_8bits);
}

void OLED_Print_Letra(uint8_t pag, uint8_t col, uint8_t font_size, char letra){ //pagina(0,7)  columna(0-127)    letra
	uint16_t pos;     //variable para almacenar la posicion recuperada de la matriz o arreglo
	letra = letra-32; //resto menos 32 para tener el codigo ASCCI

	switch(font_size){
		case 1:
				pos = letra * FONT_1_WIDTH;  //me ubico en su array correcto multiplicando por 6
				for(int i=col; i<col+FONT_1_WIDTH; i++) {
					OLED_Draw_8_Pixel(pag,i,FONT_1[pos]);
					pos++;
				}
			break;
		//////////////////////////////////////////////////////////////////////////////////////////////////
		case 2:
				pos = letra * (FONT_2_WIDTH*2);  //me ubico en su array correcto multiplico por 2 ya que la altura sera de 16pixeles utilizando 8pixles por pagina y en total usara 2 paginas

				for(int i=col; i<col+FONT_2_WIDTH; i++) {       //9
					OLED_Draw_8_Pixel(pag,i,FONT_2[pos]);
					pos++;
				}

				for(int i=col; i<col+FONT_2_WIDTH; i++) {      //9
					OLED_Draw_8_Pixel(pag+1,i,FONT_2[pos]);
					pos++;
				}
			break;
		//////////////////////////////////////////////////////////////////////////////////////////////////
		case 3:
		pos = letra * (FONT_3_WIDTH*3);  //me ubico en su array correcto multiplico por 2 ya que la altura sera de 16pixeles utilizando 8pixles por pagina y en total usara 2 paginas
		//ya que la matriz de FONT3[] que encontre en internet esta organizado de otra manera, realizo el siguiente codigo adecuandome a esa organizacion matricial
		uint16_t pos2 = (letra * (FONT_3_WIDTH*3))+1;
		uint16_t pos3 = (letra * (FONT_3_WIDTH*3))+2;

		for(int i=col; i<col+FONT_3_WIDTH; i++) {
			OLED_Draw_8_Pixel(pag,i,FONT_3[pos]);
			pos+=3;
		}

		for(int i=col; i<col+FONT_3_WIDTH; i++) {
			OLED_Draw_8_Pixel(pag+1,i,FONT_3[pos2]);
			pos2+=3;
		}

		for(int i=col; i<col+FONT_3_WIDTH; i++) {
			OLED_Draw_8_Pixel(pag+2,i,FONT_3[pos3]);
			pos3+=3;
		}
		break;
    }
}


void OLED_Print_Text(uint8_t pag, uint8_t col, uint8_t font_size, char *texto){

	switch(font_size){
		case 1:
				while(*texto != '\0'){
					OLED_Print_Letra(pag,col,1,*texto++);
					col=col+FONT_1_WIDTH; //aumento la posicion de la columna
				}
			break;
		//////////////////////////////////////////////////////////////////////////
		case 2:
				while(*texto != '\0'){
					OLED_Print_Letra(pag,col,2,*texto++);
					col=col+FONT_2_WIDTH; //aumento la posicion de la columna 9/11
				}
			break;
		///////////////////////////////////////////////////////////////////////////
		case 3:
				while(*texto != '\0'){
					OLED_Print_Letra(pag,col,3,*texto++);
					col=col+FONT_3_WIDTH; //aumento la posicion de la columna 9/11
		}
		break;
		///////////////////////////////////////////////////////////////////////////
	}
}

void OLED_Imagen(const unsigned char imagen[]){

	int k=0;

	for(int i=0;i<8;i++){
		for(int j=0;j<128;j++){
			OLED_Draw_Pixel(i,i, j,j, imagen[k]);
			k++;
		}
	}
}

void OLED_Imagen_Invert(const unsigned char imagen[]){

	int k=0;

	for(int i=0;i<8;i++){
		for(int j=0;j<128;j++){
			OLED_Draw_Pixel(i,i, j,j, ~imagen[k]);
			k++;
		}
	}
}

void OLED_Imagen_Small(uint8_t pag, uint8_t col, const unsigned char imagen[], uint8_t size_x, uint8_t size_y){

	int k=0;

	for(int i=pag;i<pag+size_y/8;i++){
		for(int j=col;j<col+size_x;j++){
			OLED_Draw_Pixel(i,i, j,j, imagen[k]);
			k++;
		}
	}
}
